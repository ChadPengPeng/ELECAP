//-----------------------------------------------------------------
// 程序描述:
//     电容触摸屏-IIC驱动程序
// 作    者: 凌智电子
// 开始日期: 2020-11-11
// 完成日期: 2020-11-11
// 修改日期: 
// 当前版本: V1.0
// 历史版本:
//  - V1.0: (2020-11-11)电容触摸屏-IIC初始化
// 调试工具: 凌智STM32H750核心板、LZE_ST_LINK2、4.3寸/2.8寸 TFT液晶屏
// 说    明: 
//    
//-----------------------------------------------------------------

//-----------------------------------------------------------------
// 头文件包含
//-----------------------------------------------------------------
#include "ctiic.h"
#include "bsp_delay.h"
#include "dev_lcd.h"
//-----------------------------------------------------------------

//-----------------------------------------------------------------
// void CT_Delay(void)
//-----------------------------------------------------------------
// 
// 函数功能: 控制I2C速度的延时
// 入口参数: 无 
// 返 回 值: 无
// 注意事项: 无
//
//-----------------------------------------------------------------
void CT_Delay(void)
{
	delay_us(2);
} 

//-----------------------------------------------------------------
// void CT_IIC_Init(void)
//-----------------------------------------------------------------
// 
// 函数功能: 电容触摸芯片IIC接口初始化
// 入口参数: 无 
// 返 回 值: 无
// 注意事项: 无
//
//-----------------------------------------------------------------
void CT_IIC_Init(void)
{					     
	GPIO_InitTypeDef GPIO_Initure;
	
	__HAL_RCC_GPIOB_CLK_ENABLE();			// 开启GPIOB时钟

	GPIO_Initure.Pin=GPIO_PIN_3;            // PB3 -> SPI3_SCK(SCLK)
	GPIO_Initure.Mode=GPIO_MODE_OUTPUT_PP;  // 推挽输出
	GPIO_Initure.Pull=GPIO_PULLUP;          // 上拉
	GPIO_Initure.Speed=GPIO_SPEED_FREQ_VERY_HIGH;     // 高速
	HAL_GPIO_Init(GPIOB,&GPIO_Initure);     // 初始化

	GPIO_Initure.Pin=GPIO_PIN_5;            // PB5 -> SPI3_MOSI(SDA)
	HAL_GPIO_Init(GPIOB,&GPIO_Initure);     // 初始化
	MCU_CT_IIC_SDA_H;	  	  
	MCU_CT_IIC_SCL_H;
}

//-----------------------------------------------------------------
// void CT_IIC_Start(void)
//-----------------------------------------------------------------
// 
// 函数功能: 产生IIC起始信号
// 入口参数: 无 
// 返 回 值: 无
// 注意事项: 无
//
//-----------------------------------------------------------------
void CT_IIC_Start(void)
{
	MCU_CT_SDA_OUT();     // sda线输出
	MCU_CT_IIC_SDA_H;	  	  
	MCU_CT_IIC_SCL_H;
	delay_us(30);
	MCU_CT_IIC_SDA_L;			// START:当CLK为高,DATA由高变低
	CT_Delay();
	MCU_CT_IIC_SCL_L;			// 钳住I2C总线，准备发送或接收数据 
}	 

//-----------------------------------------------------------------
// void CT_IIC_Stop(void)
//-----------------------------------------------------------------
// 
// 函数功能: 产生IIC停止信号
// 入口参数: 无 
// 返 回 值: 无
// 注意事项: 无
//
//-----------------------------------------------------------------
void CT_IIC_Stop(void)
{
	MCU_CT_SDA_OUT();// sda线输出
	MCU_CT_IIC_SCL_L; 
	MCU_CT_IIC_SDA_L;// STOP:当CLK为高,DATA由低变高
	delay_us(30);
	MCU_CT_IIC_SCL_H; 
	CT_Delay(); 
	MCU_CT_IIC_SDA_H;// 发送I2C总线结束信号 
}

//-----------------------------------------------------------------
// u8 CT_IIC_Wait_Ack(void)
//-----------------------------------------------------------------
// 
// 函数功能: 等待应答信号到来
// 入口参数: 无 
// 返 回 值: 1，接收应答失败.0，接收应答成功
// 注意事项: 无
//
//-----------------------------------------------------------------
u8 CT_IIC_Wait_Ack(void)
{
	u8 ucErrTime=0;

	MCU_CT_SDA_IN();      // SDA设置为输入  
	MCU_CT_IIC_SDA_H;	   
	MCU_CT_IIC_SCL_H;
	CT_Delay();
	while(MCU_CT_READ_SDA)
	{
		ucErrTime++;
		if(ucErrTime>250)
		{
			CT_IIC_Stop();
			return 1;
		} 
		CT_Delay();
	}
	MCU_CT_IIC_SCL_L;// 时钟输出0 	   
	return 0;
} 

//-----------------------------------------------------------------
// void CT_IIC_Ack(void)
//-----------------------------------------------------------------
// 
// 函数功能: 产生ACK应答
// 入口参数: 无 
// 返 回 值: 无
// 注意事项: 无
//
//-----------------------------------------------------------------
void CT_IIC_Ack(void)
{
	MCU_CT_IIC_SCL_L;
	MCU_CT_SDA_OUT(); 
	MCU_CT_IIC_SDA_L;
	CT_Delay();
	MCU_CT_IIC_SCL_H;
	CT_Delay();
	MCU_CT_IIC_SCL_L;
}
   
//-----------------------------------------------------------------
// void CT_IIC_NAck(void)
//-----------------------------------------------------------------
// 
// 函数功能: 不产生ACK应答	
// 入口参数: 无 
// 返 回 值: 无
// 注意事项: 无
//
//-----------------------------------------------------------------
void CT_IIC_NAck(void)
{
	MCU_CT_IIC_SCL_L;
	MCU_CT_SDA_OUT(); 
	MCU_CT_IIC_SDA_H;
	CT_Delay();
	MCU_CT_IIC_SCL_H;
	CT_Delay();
	MCU_CT_IIC_SCL_L;
}					 				     
		
//-----------------------------------------------------------------
// void CT_IIC_Send_Byte(u8 txd)
//-----------------------------------------------------------------
// 
// 函数功能: IIC发送一个字节
// 入口参数: u8 txd：发送的字节
// 返 回 值: 返回从机有无应答，1，有应答。0，无应答	
// 注意事项: 无
//
//-----------------------------------------------------------------
void CT_IIC_Send_Byte(u8 txd)
{                        
  u8 t; 

	MCU_CT_SDA_OUT(); 	    
	MCU_CT_IIC_SCL_L;// 拉低时钟开始数据传输 
	for(t=0;t<8;t++)
	{
		if((txd&0x80)>>7)
			MCU_CT_IIC_SDA_H;
		else
			MCU_CT_IIC_SDA_L;
		txd<<=1; 
		CT_Delay();	      
		MCU_CT_IIC_SCL_H; 
		CT_Delay();
		MCU_CT_IIC_SCL_L;	 
		CT_Delay();
	}	
} 	    

//-----------------------------------------------------------------
// u8 CT_IIC_Read_Byte(unsigned char ack)
//-----------------------------------------------------------------
// 
// 函数功能: 读1个字节 
// 入口参数: unsigned char ack：ack=1时，发送ACK，ack=0，发送nACK  
// 返 回 值: 无
// 注意事项: 无
//
//-----------------------------------------------------------------
u8 CT_IIC_Read_Byte(unsigned char ack)
{
	u8 i,receive=0;

	MCU_CT_SDA_IN();// SDA设置为输入 
	delay_us(30);
	for(i=0;i<8;i++ )
	{ 
		MCU_CT_IIC_SCL_L; 	    	   
		CT_Delay();
		MCU_CT_IIC_SCL_H;	 
		receive<<=1;
		if(MCU_CT_READ_SDA)
			receive++; 
		CT_Delay();  
	}	  				 
	if(!ack)
		CT_IIC_NAck();// 发送nACK
	else 
		CT_IIC_Ack(); // 发送ACK   

	return receive;
}

//-----------------------------------------------------------------
// End Of File
//----------------------------------------------------------------- 
